## build/conf/bblayers.conf
```bitbake
# POKY_BBLAYERS_CONF_VERSION is increased each time build/conf/bblayers.conf
# changes incompatibly
POKY_BBLAYERS_CONF_VERSION = "2"

BBPATH = "${TOPDIR}"
BBFILES ?= ""

BBLAYERS ?= " \
  /home/quentin/e-paper-meteo-display/poky/meta \
  /home/quentin/e-paper-meteo-display/poky/meta-poky \
  /home/quentin/e-paper-meteo-display/poky/meta-yocto-bsp \
  /home/quentin/e-paper-meteo-display/poky/meta-raspberrypi \
  "
```

## build/conf/local.conf
```bitbake
#
# This file is your local configuration file and is where all local user settings
# are placed. The comments in this file give some guide to the options a new user
# to the system might want to change but pretty much any configuration option can
# be set in this file. More adventurous users can look at
# local.conf.sample.extended which contains other examples of configuration which
# can be placed in this file but new users likely won't need any of them
# initially.
#
# Lines starting with the '#' character are commented out and in some cases the
# default values are provided as comments to show people example syntax. Enabling
# the option is a question of removing the # character and making any change to the
# variable as required.

# Machine configuration
MACHINE ?= "raspberrypi4-64"

# Choose a minimal image
IMAGE_INSTALL:append = " packagegroup-core-boot dhcpcd iptables wpa-supplicant"

# Set the image to build a minimal core image
IMAGE_FEATURES += " ssh-server-dropbear"

# Enable GPU firmware and bootloader for Raspberry Pi 4
RPI_USE_U_BOOT = "1"
ENABLE_UART = "1"

# Parallelization settings to speed up build
BB_NUMBER_THREADS ?= "${@oe.utils.cpu_count()}"
PARALLEL_MAKE ?= "-j ${@oe.utils.cpu_count()}"

# Set the package format
PACKAGE_CLASSES ?= "package_deb"

# Allow bitbake to reuse files to reduce build time
INHERIT += "rm_work"

# Enable debug symbols to help with troubleshooting (optional)
# DEBUG_BUILD = "1"

# Set the number of tasks to build simultaneously
BB_NUMBER_PARSE_THREADS = "4"

# Set the DL_DIR to share source downloads across builds
DL_DIR ?= "${TOPDIR}/downloads"

# SSTATE_DIR to cache shared state across builds to save time
SSTATE_DIR ?= "${TOPDIR}/sstate-cache"

# Limit disk usage and time by controlling shared state
INHERIT += "uninative"
DISTRO_FEATURES:append = " wifi"

# Set up specific Raspberry Pi configurations
GPU_MEM = "64"

# Enable serial console on the Raspberry Pi for debugging
SERIAL_CONSOLE = "115200 ttyAMA0"

# Set SD card image size (in MiB); increase if more space is required
SDIMG_ROOTFS = "8192"

# Enable resizing for additional space (optional)
RPI_EXTRA_CONFIG = "dtoverlay=vc4-fkms-v3d"
ENABLE_SPI_BUS = "1"
ENABLE_I2C = "1"

# CONF_VERSION is increased each time build/conf/ changes incompatibly and is used to
# track the version of this file when it was generated. This can safely be ignored if
# this doesn't mean anything to you.
CONF_VERSION = "2"

CORE_IMAGE_EXTRA_INSTALL += " packagegroup-base-wifi kernel-modules"
```
